## boards/shields/cardkeeb/Kconfig.defconfig
```kconfig
if SHIELD_CARDKEEB_LEFT

config ZMK_KEYBOARD_NAME
    default "Card Keeb"

config ZMK_SPLIT_ROLE_CENTRAL
    default y

endif

if SHIELD_CARDKEEB_RIGHT || SHIELD_CARDKEEB_LEFT

config ZMK_SPLIT
    default y

endif
```

## boards/shields/cardkeeb/Kconfig.shield
```kconfig
config SHIELD_CARDKEEB_LEFT
    def_bool $(shields_list_contains,cardkeeb_left)
config SHIELD_CARDKEEB_RIGHT
    def_bool $(shields_list_contains,cardkeeb_right)
```

## boards/shields/cubekeeb/Kconfig.defconfig
```kconfig
if SHIELD_CUBEKEEB_RIGHT

config ZMK_KEYBOARD_NAME
    default "Cube Keeb"

config ZMK_SPLIT_ROLE_CENTRAL
    default y

endif

if SHIELD_CUBEKEEB_RIGHT || SHIELD_CUBEKEEB_LEFT

config ZMK_SPLIT
    default y

config ZMK_BLE
    default y


endif
```

## boards/shields/cubekeeb/Kconfig.shield
```kconfig
config SHIELD_CUBEKEEB_LEFT
    def_bool $(shields_list_contains,cubekeeb_left)
config SHIELD_CUBEKEEB_RIGHT
    def_bool $(shields_list_contains,cubekeeb_right)
```

## boards/shields/slimkeeb/Kconfig.defconfig
```kconfig
if SHIELD_SLIMKEEB_RIGHT

config ZMK_KEYBOARD_NAME
    default "Slimkeeb36"

config ZMK_SPLIT_ROLE_CENTRAL
    default y

endif

if SHIELD_SLIMKEEB_RIGHT || SHIELD_SLIMKEEB_LEFT

config ZMK_SPLIT
    default y

config ZMK_BLE
    default y


endif
```

## boards/shields/slimkeeb/Kconfig.shield
```kconfig
config SHIELD_SLIMKEEB_LEFT
    def_bool $(shields_list_contains,slimkeeb_left)
config SHIELD_SLIMKEEB_RIGHT
    def_bool $(shields_list_contains,slimkeeb_right)
```
